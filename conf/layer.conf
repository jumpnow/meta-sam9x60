## conf/layer.conf
```bitbake
# We have a conf and classes directory, append to BBPATH
BBPATH .= ":${LAYERDIR}"

# We have a recipes directory, add to BBFILES
BBFILES += "${LAYERDIR}/recipes*/*/*.bb ${LAYERDIR}/recipes*/*/*.bbappend ${LAYERDIR}/images/*.bb"

BBFILE_COLLECTIONS += "meta-sam9x60"
BBFILE_PATTERN_meta-sam9x60 := "^${LAYERDIR}/"
BBFILE_PRIORITY_meta-sam9x60 = "16"

LAYERSERIES_COMPAT_meta-sam9x60 = "mickledore"
```
